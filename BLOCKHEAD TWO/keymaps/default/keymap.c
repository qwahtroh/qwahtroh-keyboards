#include "BLOCKHEAD.h"

#define ____ KC_TRNS

// Layers
enum layer_names {
  _BASE,
  _GAME,
  _FUNCTION
};

const uint16_t PROGMEM keymaps[][MATRIX_ROWS][MATRIX_COLS] = {
/* BASE
  .----------------------------------------------------------------------------.
  |      |  UP  | GAME |             |  F1  |  F2  |  F3  |  F4  |  F5  |  F6  |
  |------+------+------|             |------+------+------+------+------+------|
  | LEFT | DOWN | RIGHT|             |  F7  |  F8  |  F9  |  F10 |  F11 |  F12 |
  `----------------------------------------------------------------------------`
  .----------------------------------------------------------------------------.
  |  ESC |   1  |   2  |   3  |   4  |   5  |   6  |   7  |   8  |   9  |   0  |
  |------+------+------+------+------+------+------+------+------+------+------|
  |  TAB |   Q  |   W  |   E  |   R  |   T  |   Y  |   U  |   I  |   O  |   P  |
  |------+------+------+------+------+------+------+------+------+------+------|
  |  CTL |   A  |   S  |   D  |   F  |   G  |   H  |   J  |   K  |   L  |      |
  |------+------+------+------+------+------+------+------+------+------+------|
  |  SFT |   Z  |   X  |   C  |   V  |   B  |   N  |   M  |   ,  |   .  |   /  |
  |------+------+------+------+------+------+------+------+------+------+------|
  |  DEL |  WIN |  ALT |  CTL |  FN  |  SPC | BSCP |  SFT |      |      |  ENT |
  `----------------------------------------------------------------------------`
*/
  	[_BASE] = LAYOUT (
    KC_F13,      KC_UP,     TG(_GAME),                                  KC_F1,     KC_F2,    KC_F3,     KC_F4,     KC_F5,      KC_F6,
    KC_LEFT,     KC_DOWN,   KC_RIGHT,                                   KC_F7,     KC_F8,    KC_F9,     KC_F10,    KC_F11,     KC_F12,

    KC_ESC,      KC_1,      KC_2,        KC_3,      KC_4,               KC_5,      KC_6,     KC_7,      KC_8,      KC_9,       KC_0,
    KC_TAB,      KC_Q,      KC_W,        KC_E,      KC_R,               KC_T,      KC_Y,     KC_U,      KC_I,      KC_O,       KC_P,
    KC_LCTL,     KC_A,      KC_S,        KC_D,      KC_F,               KC_G,      KC_H,     KC_J,      KC_K,      KC_L,       KC_SCLN,
    KC_LSHIFT,   KC_Z,      KC_X,        KC_C,      KC_V,               KC_B,      KC_N,     KC_M,      KC_COMM,   KC_DOT,     KC_SLSH,
    KC_DEL,      KC_LGUI,   KC_LALT,     KC_LCTL,   MO(_FUNCTION),      KC_BSPC,   KC_SPC,   KC_LSFT,   KC_LALT,   KC_LGUI,    KC_ENT
    ),
  
/* GAME (NUMBERS AND SYMBOLS)
  .----------------------------------------------------------------------------.
  |      |      | BASE |             |      |      |      |      |      |      |
  |------+------+------|             |------+------+------+------+------+------|
  |      |      |      |             |      |      |      |      |      |      |
  `----------------------------------------------------------------------------`
  .----------------------------------------------------------------------------.
  |      |      |      |      |      |      |      |      |      |      |      |
  |------+------+------+------+------+------+------+------+------+------+------|
  |      |      |      |      |      |      |      |      |      |      |      |
  |------+------+------+------+------+------+------+------+------+------+------|
  |      |      |      |      |      |      |      |      |      |      |      |
  |------+------+------+------+------+------+------+------+------+------+------|
  |      |      |      |      |      |      |      |      |      |      |      |
  |------+------+------+------+------+------+------+------+------+------+------|
  |      |      |      |      |      |      |      |      |      |      |      |
  `----------------------------------------------------------------------------`
 */  
    [_GAME] = LAYOUT (
    KC_F13,      KC_UP,     TO(_BASE),                                  KC_F1,     KC_F2,    KC_F3,     KC_F4,     KC_F5,      KC_F6,
    KC_LEFT,     KC_DOWN,   KC_RIGHT,                                   KC_F7,     KC_F8,    KC_F9,     KC_F10,    KC_F11,     KC_F12,
      
    KC_ESC,      KC_1,      KC_2,        KC_3,      KC_4,               KC_5,      KC_6,     KC_7,      KC_8,      KC_9,       KC_0,
    KC_TAB,      KC_Q,      KC_W,        KC_E,      KC_R,               KC_T,      KC_Y,     KC_U,      KC_I,      KC_O,       KC_P,
    KC_LCTL,     KC_A,      KC_S,        KC_D,      KC_F,               KC_G,      KC_H,     KC_J,      KC_K,      KC_L,       KC_QUOT,
    KC_LSHIFT,   KC_Z,      KC_X,        KC_C,      KC_V,               KC_B,      KC_N,     KC_M,      KC_COMM,   KC_DOT,     KC_SLSH,
    KC_DEL,      KC_LGUI,   KC_LALT,     KC_LCTL,   KC_SPC,             KC_BSPC,   KC_SPC,   KC_LSFT,   KC_LALT,   KC_LGUI,    KC_ENT
    ),

/* FUNCTION (NAVIGATION, FUNCTIONS, AND SETTINGS)
  .----------------------------------------------------------------------------.
  |      |      | RESET|             |      |      |      |      |      |      |
  |------+------+------|             |------+------+------+------+------+------|
  |      |      |      |             |      |      |      |      |      |      |
  `----------------------------------------------------------------------------`
  .----------------------------------------------------------------------------.
  |      |      |      |      |      |      |      |      |      |      |      |
  |------+------+------+------+------+------+------+------+------+------+------|
  |      |      |      |      |      |      |      |      |      |      |      |
  |------+------+------+------+------+------+------+------+------+------+------|
  |      |      |      |      |      |      |      |      |      |      |      |
  |------+------+------+------+------+------+------+------+------+------+------|
  |      |      |      |      |      |      |      |      |      |      |      |
  |------+------+------+------+------+------+------+------+------+------+------|
  |      |      |      |      |      |      |      |      |      |      |      |
  `----------------------------------------------------------------------------`
*/  
    [_FUNCTION] = LAYOUT (
    KC_ESC,      KC_UP,     XXXXXXX,                                    RGB_TOG,   RGB_MOD,     RGB_HUI,     RGB_SAI,     RGB_VAI,     RGB_M_R,
    KC_LEFT,     KC_DOWN,   KC_RIGHT,                                   RGB_M_P,   RGB_RMOD,    RGB_HUD,     RGB_SAD,     RGB_VAD,     RGB_M_B,
        
    XXXXXXX,    XXXXXXX,    XXXXXXX,      XXXXXXX,    XXXXXXX,          XXXXXXX,   XXXXXXX,     XXXXXXX,     XXXXXXX,     KC_LBRC,     KC_RBRC,
    XXXXXXX,    XXXXXXX,    XXXXXXX,      XXXXXXX,    XXXXXXX,          XXXXXXX,   XXXXXXX,     XXXXXXX,     KC_PGUP,     KC_MINS,     KC_EQL,
    KC_CAPS,    XXXXXXX,    XXXXXXX,      XXXXXXX,    XXXXXXX,          XXXXXXX,   XXXXXXX,     KC_HOME,     KC_PGDN,     KC_END,      KC_SCLN,
    XXXXXXX,    XXXXXXX,    XXXXXXX,      XXXXXXX,    RESET,            XXXXXXX,   XXXXXXX,     XXXXXXX,     XXXXXXX,     XXXXXXX,     KC_BSLS,
    KC_DEL,     KC_LGUI,    KC_LALT,      KC_LCTL,    MO(_FUNCTION),    KC_BSPC,   KC_SPC,      KC_LSFT,     KC_LALT,     KC_LGUI,     KC_ENT
    )
  };


bool encoder_update_user(uint8_t index, bool clockwise) {
  if(IS_LAYER_ON(_FUNCTION)) { // on Function layer control volume
    if (clockwise){
      rgblight_increase_hue();
    } else{
      rgblight_decrease_hue(); 
    }        
  } else { // on other layers page up/down
    if (clockwise){
      tap_code(KC_VOLU);
    } else{
      tap_code(KC_VOLD);
    }
  }
  return true;
}

static void render_logo(void) {
    static const char PROGMEM name_logo[] = {

//aithan
0x00, 0x80, 0x80, 0x80, 0x80, 0x80, 0x80, 0x7e, 0x7e, 0x7e, 0x7e, 0x7e, 0x7e, 0x7e, 0x7e, 0x7e, 
0x7e, 0x7e, 0x7e, 0x80, 0x80, 0x80, 0x80, 0x80, 0x80, 0x00, 0x00, 0x00, 0x00, 0x00, 0x00, 0x1e, 
0x1e, 0x1e, 0x1e, 0xfe, 0xfe, 0xfe, 0xfe, 0x1e, 0x1e, 0x1e, 0x1e, 0x00, 0x00, 0x00, 0x00, 0x1e, 
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0x00, 0x00, 0x00, 0x00, 0x00, 0x00, 0x00, 0x00, 0x00, 0x00, 0x00, 0x00, 0x00, 0x00, 0x00, 0x00


//aidan
/*0x00, 0x00, 0x00, 0x00, 0x00, 0x00, 0x00, 0x00, 0x00, 0x00, 0x00, 0x00, 0x00, 0x80, 0x80, 0x80, 
0x80, 0x80, 0x80, 0x7e, 0x7e, 0x7e, 0x7e, 0x7e, 0x7e, 0x7e, 0x7e, 0x7e, 0x7e, 0x7e, 0x7e, 0x80, 
0x80, 0x80, 0x80, 0x80, 0x80, 0x00, 0x00, 0x00, 0x00, 0x00, 0x00, 0x1e, 0x1e, 0x1e, 0x1e, 0xfe, 
0xfe, 0xfe, 0xfe, 0x1e, 0x1e, 0x1e, 0x1e, 0x00, 0x00, 0x00, 0x00, 0xfe, 0xfe, 0xfe, 0xfe, 0x1e, 
0x1e, 0x1e, 0x1e, 0x1e, 0x1e, 0x1e, 0x1e, 0xe0, 0xe0, 0xe0, 0xe0, 0x00, 0x00, 0x00, 0x00, 0xe0, 
0xe0, 0xe0, 0xe0, 0x1e, 0x1e, 0x1e, 0x1e, 0x1e, 0x1e, 0x1e, 0x1e, 0xe0, 0xe0, 0xe0, 0xe0, 0x00, 
0x00, 0x00, 0x00, 0xfe, 0xfe, 0xfe, 0xfe, 0xe0, 0xe0, 0xe0, 0xe0, 0x00, 0x00, 0x00, 0x00, 0xfe, 
0xfe, 0xfe, 0xfe, 0x00, 0x00, 0x00, 0x00, 0x00, 0x00, 0x00, 0x00, 0x00, 0x00, 0x00, 0x00, 0x00, 
0x00, 0x00, 0x00, 0x00, 0x00, 0x00, 0x00, 0x00, 0x00, 0x00, 0x00, 0x00, 0x00, 0xff, 0xff, 0xff, 
0xff, 0xff, 0xff, 0xe0, 0xe0, 0xe0, 0xe0, 0xe0, 0xe0, 0xe0, 0xe0, 0xe0, 0xe0, 0xe0, 0xe0, 0xff, 
0xff, 0xff, 0xff, 0xff, 0xff, 0x00, 0x00, 0x00, 0x00, 0x00, 0x00, 0x00, 0x00, 0x00, 0x00, 0xff, 
0xff, 0xff, 0xff, 0x00, 0x00, 0x00, 0x00, 0x00, 0x00, 0x00, 0x00, 0xff, 0xff, 0xff, 0xff, 0x00, 
0x00, 0x00, 0x00, 0x00, 0x00, 0x00, 0x00, 0xff, 0xff, 0xff, 0xff, 0x00, 0x00, 0x00, 0x00, 0xff, 
0xff, 0xff, 0xff, 0x1e, 0x1e, 0x1e, 0x1e, 0x1e, 0x1e, 0x1e, 0x1e, 0xff, 0xff, 0xff, 0xff, 0x00, 
0x00, 0x00, 0x00, 0xff, 0xff, 0xff, 0xff, 0x01, 0x01, 0x01, 0x01, 0x1e, 0x1e, 0x1e, 0x1e, 0xff, 
0xff, 0xff, 0xff, 0x00, 0x00, 0x00, 0x00, 0x00, 0x00, 0x00, 0x00, 0x00, 0x00, 0x00, 0x00, 0x00, 
0x00, 0x00, 0x00, 0x00, 0x00, 0x00, 0x00, 0x00, 0x00, 0x00, 0x00, 0x00, 0x00, 0xff, 0xff, 0xff, 
0xff, 0xff, 0xff, 0x07, 0x07, 0x07, 0x07, 0x07, 0x07, 0x07, 0x07, 0x07, 0x07, 0x07, 0x07, 0xff, 
0xff, 0xff, 0xff, 0xff, 0xff, 0x00, 0x00, 0x00, 0x00, 0x00, 0x00, 0x1e, 0x1e, 0x1e, 0x1e, 0x1f, 
0x1f, 0x1f, 0x1f, 0x1e, 0x1e, 0x1e, 0x1e, 0x00, 0x00, 0x00, 0x00, 0x1f, 0x1f, 0x1f, 0x1f, 0x1e, 
0x1e, 0x1e, 0x1e, 0x1e, 0x1e, 0x1e, 0x1e, 0x01, 0x01, 0x01, 0x01, 0x00, 0x00, 0x00, 0x00, 0x1f, 
0x1f, 0x1f, 0x1f, 0x00, 0x00, 0x00, 0x00, 0x00, 0x00, 0x00, 0x00, 0x1f, 0x1f, 0x1f, 0x1f, 0x00, 
0x00, 0x00, 0x00, 0x1f, 0x1f, 0x1f, 0x1f, 0x00, 0x00, 0x00, 0x00, 0x00, 0x00, 0x00, 0x00, 0x1f, 
0x1f, 0x1f, 0x1f, 0x00, 0x00, 0x00, 0x00, 0x00, 0x00, 0x00, 0x00, 0x00, 0x00, 0x00, 0x00, 0x00, 
0x00, 0x00, 0x00, 0x00, 0x00, 0x00, 0x00, 0x00, 0x00, 0x00, 0x00, 0x00, 0x00, 0x7f, 0x7f, 0x7f, 
0x7f, 0x7f, 0x7f, 0x00, 0x00, 0x00, 0x00, 0x00, 0x00, 0x00, 0x00, 0x00, 0x00, 0x00, 0x00, 0x7f, 
0x7f, 0x7f, 0x7f, 0x7f, 0x7f, 0x00, 0x00, 0x00, 0x00, 0x00, 0x00, 0x00, 0x00, 0x00, 0x00, 0x00, 
0x00, 0x00, 0x00, 0x00, 0x00, 0x00, 0x00, 0x00, 0x00, 0x00, 0x00, 0x00, 0x00, 0x00, 0x00, 0x00, 
0x00, 0x00, 0x00, 0x00, 0x00, 0x00, 0x00, 0x00, 0x00, 0x00, 0x00, 0x00, 0x00, 0x00, 0x00, 0x00, 
0x00, 0x00, 0x00, 0x00, 0x00, 0x00, 0x00, 0x00, 0x00, 0x00, 0x00, 0x00, 0x00, 0x00, 0x00, 0x00, 
0x00, 0x00, 0x00, 0x00, 0x00, 0x00, 0x00, 0x00, 0x00, 0x00, 0x00, 0x00, 0x00, 0x00, 0x00, 0x00, 
0x00, 0x00, 0x00, 0x00, 0x00, 0x00, 0x00, 0x00, 0x00, 0x00, 0x00, 0x00, 0x00, 0x00, 0x00, 0x00*/
              };

  oled_write_raw_P(name_logo, sizeof(name_logo));
  }


#ifdef OLED_DRIVER_ENABLE

/*static void render_display(void) {
    //oled_set_cursor(0,0);
    render_logo();
    //oled_scroll_left();
}*/

void oled_task_user(void) {
  oled_set_cursor(0,15);
  render_logo();
  oled_scroll_left();

}

#endif